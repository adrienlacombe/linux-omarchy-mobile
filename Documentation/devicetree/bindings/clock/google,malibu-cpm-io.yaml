## drivers/ufs/host/Kconfig
```kconfig
# SPDX-License-Identifier: GPL-2.0+
#
# Kernel configuration file for the UFS host controller drivers.
#
# Copyright (C) 2011-2013 Samsung India Software Operations
#
# Authors:
#	Santosh Yaraganavi <santosh.sy@samsung.com>
#	Vinayak Holikatti <h.vinayak@samsung.com>

config SCSI_UFSHCD_PCI
	tristate "PCI bus based UFS Controller support"
	depends on PCI
	help
	  This selects the PCI UFS Host Controller Interface. Select this if
	  you have UFS Host Controller with PCI Interface.

	  If you have a controller with this interface, say Y or M here.

	  If unsure, say N.

config SCSI_UFS_DWC_TC_PCI
	tristate "DesignWare pci support using a G210 Test Chip"
	depends on SCSI_UFSHCD_PCI
	help
	  Synopsys Test Chip is a PHY for prototyping purposes.

	  If unsure, say N.

config SCSI_UFSHCD_PLATFORM
	tristate "Platform bus based UFS Controller support"
	depends on HAS_IOMEM
	help
	  This selects the UFS host controller support. Select this if
	  you have an UFS controller on Platform bus.

	  If you have a controller with this interface, say Y or M here.

	  If unsure, say N.

config SCSI_UFS_MALIBU
	bool "Google Malibu UFS link diagnostic"
	depends on SCSI_UFSHCD_PLATFORM=y && COMMON_CLK_GOOGLE_MALIBU_CPM=y
	depends on GPIOLIB && PINCTRL
	depends on ARM_SMMU_V3 && IOMMU_DMA
	help
	  Build the Google Tensor G6 Malibu UFS bring-up code.
	  The code sets up the device supplies and GPIOs, checks
	  bootloader calibration data and programs the local UniPro
	  attributes before a synchronous link test. It releases the clock
	  votes only after Hibern8 and PHY power-state checks. On an
	  unqualified exit it keeps the acquired votes for this boot.
	  The diagnostic does not register a SCSI host or storage.

	  If unsure, say N.

config SCSI_UFS_MALIBU_HIBERN8_GATING_DIAG
	bool "Test stock Grizzly M-PHY Hibern8 gating"
	depends on SCSI_UFS_MALIBU && COMMON_CLK_GOOGLE_MALIBU_CPM_UFS_PREP_RELEASE
	help
	  Apply the stock D1 local M-PHY Hibern8 gating attribute
	  after link startup and test one explicit Hibern8 entry.
	  Keep the existing Deep H8 release guard and leave the host
	  without transfer queues or SCSI devices.
	  Leave disabled except when testing Grizzly diagnostics.

config SCSI_UFS_MALIBU_QUERY_DIAG
	bool "Test Grizzly device management before SCSI discovery"
	depends on SCSI_UFS_MALIBU_HIBERN8_GATING_DIAG
	help
	  Use one polled legacy transfer slot to send a NOP and read
	  bRefClkFreq on the Grizzly link diagnostic. Do not register
	  a SCSI host or start task management, scanning or recovery.
	  Leave disabled outside Grizzly diagnostic builds.

config SCSI_UFS_MALIBU_DEVICE_INIT_DIAG
	bool "Test Grizzly fDeviceInit before SCSI discovery"
	depends on SCSI_UFS_MALIBU_QUERY_DIAG
	help
	  After the clock query passes, issue one fDeviceInit SET
	  and wait for the device to clear that flag. Continue with
	  the link-only teardown and do not enumerate any LUNs.
	  Leave disabled outside Grizzly diagnostic builds.

config SCSI_UFS_MALIBU_SCSI_INQUIRY_DIAG
	bool "Test one Grizzly SCSI INQUIRY before discovery"
	depends on SCSI_UFS_MALIBU_DEVICE_INIT_DIAG
	help
	  After the device clears fDeviceInit, send a standard 36-byte
	  INQUIRY to LUN 0 over the polled link diagnostic slot. Validate
	  the response without registering a SCSI host or scanning for disks.
	  Leave disabled outside Grizzly diagnostic builds.

config SCSI_UFS_MALIBU_INQUIRY_IRQ_DIAG
	bool "Require a transfer IRQ for the Grizzly INQUIRY test"
	depends on SCSI_UFS_MALIBU_SCSI_INQUIRY_DIAG
	help
	  Keep the preflight commands polled and wait for the single INQUIRY
	  on the hardware transfer completion interrupt. Do not fall back
	  to polling if the interrupt is missing.
	  Leave disabled outside Grizzly diagnostic builds.

config SCSI_UFS_MALIBU_CAPACITY_DIAG
	bool "Test Grizzly READ CAPACITY(10) before discovery"
	depends on SCSI_UFS_MALIBU_INQUIRY_IRQ_DIAG
	help
	  After a successful INQUIRY, read the last logical block address
	  and block size of LUN 0 using the hardware transfer interrupt.
	  Do not scan for disks or read any logical blocks.
	  Leave disabled outside Grizzly diagnostic builds.

config SCSI_UFS_MALIBU_LBA0_DIAG
	bool "Test one Grizzly LUN 0 block read before discovery"
	depends on SCSI_UFS_MALIBU_CAPACITY_DIAG
	help
	  If READ CAPACITY reports 4096-byte blocks, read exactly one
	  block at LBA 0 of LUN 0. Log DMA and MBR signature checks without
	  exposing the block contents or scanning for partitions.
	  Leave disabled outside Grizzly diagnostic builds.

config SCSI_UFS_MALIBU_GPT_HEADER_DIAG
	bool "Test the Grizzly primary GPT header before discovery"
	depends on SCSI_UFS_MALIBU_LBA0_DIAG
	select CRC32
	help
	  After the single LBA 0 read, read LBA 1 on LUN 0 and verify
	  the primary GPT header CRC. Report the result without logging
	  the header contents. Do not scan or read the entry array.
	  Leave disabled outside Grizzly diagnostic builds.

config SCSI_UFS_MALIBU_GPT_ENTRIES_DIAG
	bool "Test the Grizzly primary GPT entry array before discovery"
	depends on SCSI_UFS_MALIBU_GPT_HEADER_DIAG
	help
	  After validating the primary header, read at most four blocks
	  from LBA 2 and check the GPT entry-array CRC. Do not parse or log
	  partition entries or scan for disks.
	  Leave disabled outside Grizzly diagnostic builds.

config SCSI_UFS_MALIBU_HOST_REGISTRATION_DIAG
	bool "Test Grizzly SCSI host registration before discovery"
	depends on SCSI_UFS_MALIBU_GPT_ENTRIES_DIAG
	help
	  After the guarded GPT reads finish, register the SCSI host in
	  legacy mode with command dispatch blocked. Verify it has no
	  discovered devices, then remove it before HCI cleanup.
	  Leave disabled outside Grizzly diagnostic builds.

config SCSI_UFS_MALIBU_REPORT_LUNS_DIAG
	bool "Test Grizzly REPORT LUNS without scanning"
	depends on SCSI_UFS_MALIBU_HOST_REGISTRATION_DIAG
	help
	  After the guarded reads, request the ordinary LUN list from
	  the REPORT LUNS well-known LUN. Validate and log LUN numbers
	  without attaching disks or issuing a command to another LUN.
	  Leave disabled outside Grizzly diagnostic builds.

config SCSI_UFS_MALIBU_MIDLAYER_INQUIRY_DIAG
	bool "Test one Grizzly SCSI midlayer INQUIRY"
	depends on SCSI_UFS_MALIBU_REPORT_LUNS_DIAG
	help
	  Read the 36-byte standard INQUIRY response from LUN 0 through
	  the SCSI core pseudo-device in legacy mode. Remove the host
	  without scanning or attaching disks. Restart the diagnostic
	  if a timed-out DMA transfer cannot be stopped safely.
	  Enable this only in Grizzly diagnostic builds.

config SCSI_UFS_CDNS_PLATFORM
	tristate "Cadence UFS Controller platform driver"
	depends on SCSI_UFSHCD_PLATFORM
	help
	  This selects the Cadence-specific additions to UFSHCD platform driver.

	  If unsure, say N.

config SCSI_UFS_DWC_TC_PLATFORM
	tristate "DesignWare platform support using a G210 Test Chip"
	depends on OF && SCSI_UFSHCD_PLATFORM
	help
	  Synopsys Test Chip is a PHY for prototyping purposes.

	  If unsure, say N.

config SCSI_UFS_QCOM
	tristate "Qualcomm specific hooks to UFS controller platform driver"
	depends on SCSI_UFSHCD_PLATFORM && ARCH_QCOM
	depends on GENERIC_MSI_IRQ
	depends on RESET_CONTROLLER
	select QCOM_INLINE_CRYPTO_ENGINE if SCSI_UFS_CRYPTO
	help
	  This selects the QCOM specific additions to UFSHCD platform driver.
	  UFS host on QCOM needs some vendor specific configuration before
	  accessing the hardware which includes PHY configuration and vendor
	  specific registers.

	  Select this if you have UFS controller on QCOM chipset.
	  If unsure, say N.

config SCSI_UFS_MEDIATEK
	tristate "Mediatek specific hooks to UFS controller platform driver"
	depends on SCSI_UFSHCD_PLATFORM && ARCH_MEDIATEK
	depends on PM
	depends on RESET_CONTROLLER
	select PHY_MTK_UFS
	select RESET_TI_SYSCON
	help
	  This selects the Mediatek specific additions to UFSHCD platform driver.
	  UFS host on Mediatek needs some vendor specific configuration before
	  accessing the hardware which includes PHY configuration and vendor
	  specific registers.

	  Select this if you have UFS controller on Mediatek chipset.

	  If unsure, say N.

config SCSI_UFS_HISI
	tristate "Hisilicon specific hooks to UFS controller platform driver"
	depends on (ARCH_HISI || COMPILE_TEST) && SCSI_UFSHCD_PLATFORM
	help
	  This selects the Hisilicon specific additions to UFSHCD platform driver.

	  Select this if you have UFS controller on Hisilicon chipset.
	  If unsure, say N.

config SCSI_UFS_RENESAS
	tristate "Renesas specific hooks to UFS controller platform driver"
	depends on (ARCH_RENESAS || COMPILE_TEST) && SCSI_UFSHCD_PLATFORM
	help
	  This selects the Renesas specific additions to UFSHCD platform driver.
	  UFS host on Renesas needs some vendor specific configuration before
	  accessing the hardware.

	  Select this if you have UFS controller on Renesas chipset.

	  If unsure, say N.

config SCSI_UFS_TI_J721E
	tristate "TI glue layer for Cadence UFS Controller"
	depends on OF && HAS_IOMEM && (ARCH_K3 || COMPILE_TEST)
	help
	  This selects driver for TI glue layer for Cadence UFS Host
	  Controller IP.

	  Selects this if you have TI platform with UFS controller.
	  If unsure, say N.

config SCSI_UFS_EXYNOS
	tristate "Exynos specific hooks to UFS controller platform driver"
	depends on SCSI_UFSHCD_PLATFORM && (ARCH_EXYNOS || COMPILE_TEST)
	help
	  This selects the Samsung Exynos SoC specific additions to UFSHCD
	  platform driver.  UFS host on Samsung Exynos SoC includes HCI and
	  UNIPRO layer, and associates with UFS-PHY driver.

	  Select this if you have UFS host controller on Samsung Exynos SoC.
	  If unsure, say N.

config SCSI_UFS_VARIABLE_SG_ENTRY_SIZE
	bool
	default y if SCSI_UFS_EXYNOS && SCSI_UFS_CRYPTO

config SCSI_UFS_SPRD
	tristate "Unisoc specific hooks to UFS controller platform driver"
	depends on SCSI_UFSHCD_PLATFORM && (ARCH_SPRD || COMPILE_TEST)
	help
	  This selects the Unisoc specific additions to UFSHCD platform driver.
	  UFS host on Unisoc needs some vendor specific configuration before
	  accessing the hardware which includes PHY configuration and vendor
	  specific registers.

	  Select this if you have UFS controller on Unisoc chipset.
	  If unsure, say N.

config SCSI_UFS_ROCKCHIP
	tristate "Rockchip UFS host controller driver"
	depends on SCSI_UFSHCD_PLATFORM && (ARCH_ROCKCHIP || COMPILE_TEST)
	help
	  This selects the Rockchip specific additions to UFSHCD platform driver.
	  UFS host on Rockchip needs some vendor specific configuration before
	  accessing the hardware which includes PHY configuration and vendor
	  specific registers.

	  Select this if you have UFS controller on Rockchip chipset.
	  If unsure, say N.

config SCSI_UFS_AMD_VERSAL2
	tristate "AMD Versal Gen 2 UFS controller platform driver"
	depends on SCSI_UFSHCD_PLATFORM && (ARCH_ZYNQMP || COMPILE_TEST)
	help
	  This selects the AMD Versal Gen 2 specific additions on top of
	  the UFSHCD DWC and UFSHCD platform driver. UFS host on AMD
	  Versal Gen 2 needs some vendor specific configurations like PHY
	  and vendor specific register accesses before accessing the
	  hardware.

	  Select this if you have UFS controller on AMD Versal Gen 2 SoC.
	  If unsure, say N.
```
