## Documentation/devicetree/bindings/clock/google,malibu-cpm-io.yaml
```yaml
# SPDX-License-Identifier: (GPL-2.0-only OR BSD-2-Clause)
%YAML 1.2
---
$id: http://devicetree.org/schemas/clock/google,malibu-cpm-io.yaml#
$schema: http://devicetree.org/meta-schemas/core.yaml#

title: Google Tensor G6 CPM I/O resource controller

maintainers:
  - Peter Griffin <peter.griffin@linaro.org>

description: |
  CPM controls the clocks and resets for the HSION USB2, LSIOE I2C3
  and HSIOS UFS controllers and their power domain hierarchies. It also controls
  the Grizzly display power domain hierarchy. The host uses
  separate MBA v3 queues for requests and replies. Clock, reset and
  power domain indices are defined in google,malibu-cpm-io.h.

properties:
  compatible:
    const: google,malibu-cpm-io

  mboxes:
    items:
      - description: Request mailbox.
      - description: Response mailbox.

  mbox-names:
    items:
      - const: tx
      - const: rx

  '#clock-cells':
    const: 1

  '#reset-cells':
    const: 1

  '#power-domain-cells':
    const: 1
    description: |
      Domain 0 is HSION, domain 1 is the USB top, and domain 2 is the
      USB power switch. USB top is a child of HSION and the switch is
      a child of USB top. Domain 3 is LSIOE and domain 4 is its client
      domain for I2C3. Domain 5 is HSIOS, domain 6 is the UFS preparation
      domain, and domain 7 is the UFS core. UFS preparation is a child of
      HSIOS and UFS core is a child of UFS preparation. On Grizzly, domain
      8 is the DPU wrapper, domain 9 is its back end, and domain 10 is
      DSI0. The back end is a child of the wrapper and DSI0 is a child of
      the back end.

  regulators:
    type: object
    description: Fixed-voltage eUSB2 rails exposed by the DA9188 and DA9189 service.
    additionalProperties: false

    properties:
      ldo-19m:
        $ref: /schemas/regulator/regulator.yaml#
        unevaluatedProperties: false
        description: Switchable 3.3 V DA9188 rail.
        properties:
          regulator-name:
            const: ldo_19m
          regulator-min-microvolt:
            const: 3300000
          regulator-max-microvolt:
            const: 3300000
          regulator-always-on: false
          regulator-boot-on: false
        required:
          - regulator-name
          - regulator-min-microvolt
          - regulator-max-microvolt

      buck-12s:
        $ref: /schemas/regulator/regulator.yaml#
        unevaluatedProperties: false
        description: Always-on 1.85 V DA9189 rail.
        properties:
          regulator-name:
            const: buck_12s
          regulator-min-microvolt:
            const: 1850000
          regulator-max-microvolt:
            const: 1850000
        required:
          - regulator-name
          - regulator-min-microvolt
          - regulator-max-microvolt
          - regulator-always-on

      ldo-12s:
        $ref: /schemas/regulator/regulator.yaml#
        unevaluatedProperties: false
        description: Always-on 1.2 V DA9189 rail.
        properties:
          regulator-name:
            const: ldo_12s
          regulator-min-microvolt:
            const: 1200000
          regulator-max-microvolt:
            const: 1200000
        required:
          - regulator-name
          - regulator-min-microvolt
          - regulator-max-microvolt
          - regulator-always-on

    required:
      - ldo-19m
      - buck-12s
      - ldo-12s

  ufs-regulators:
    type: object
    description: DA9189 UFS analog and GPIO-switched device rails.
    additionalProperties: false
    properties:
      ldo-1s:
        $ref: '#/$defs/ufs-rail'
        description: 0.75 V HSIO analog supply.
      ldo-24s:
        $ref: '#/$defs/ufs-rail'
        description: 1.2 V HSIO analog supply.
      buck-11s:
        $ref: '#/$defs/ufs-rail'
        description: 2.5 V device VCC supply.
      buck-13s:
        $ref: '#/$defs/ufs-rail'
        description: 1.2 V device VCCQ supply.
    required:
      - ldo-1s
      - ldo-24s
      - buck-11s
      - buck-13s

$defs:
  ufs-rail:
    $ref: /schemas/regulator/regulator.yaml#
    unevaluatedProperties: false
    properties:
      regulator-boot-on: false
      regulator-always-on: false
    required:
      - regulator-name
      - regulator-min-microvolt
      - regulator-max-microvolt

required:
  - compatible
  - mboxes
  - mbox-names
  - '#clock-cells'
  - '#reset-cells'

additionalProperties: false
```

## Documentation/devicetree/bindings/display/google,malibu-dc9x00.yaml
```yaml
# SPDX-License-Identifier: (GPL-2.0-only OR BSD-2-Clause)
%YAML 1.2
---
$id: http://devicetree.org/schemas/display/google,malibu-dc9x00.yaml#
$schema: http://devicetree.org/meta-schemas/core.yaml#

title: Google Malibu DC9x00 display controller

maintainers:
  - Peter Griffin <peter.griffin@linaro.org>

description:
  The Google Malibu DC9x00 display controller has a dedicated frame-start
  interrupt for output 0, routed through the display interrupt aggregators.

properties:
  compatible:
    const: google,malibu-dc9x00

  reg:
    maxItems: 1

  interrupts:
    maxItems: 1

  interrupt-names:
    const: frame-start

  power-domains:
    maxItems: 1

required:
  - compatible
  - reg
  - interrupts
  - interrupt-names
  - power-domains

additionalProperties: false
```

## Documentation/devicetree/bindings/gpio/google,malibu-aoss-alert-gpio.yaml
```yaml
# SPDX-License-Identifier: (GPL-2.0-only OR BSD-2-Clause)
%YAML 1.2
---
$id: http://devicetree.org/schemas/gpio/google,malibu-aoss-alert-gpio.yaml#
$schema: http://devicetree.org/meta-schemas/core.yaml#

title: Google Tensor G6 AOSS Type-C alert GPIO

maintainers:
  - Peter Griffin <peter.griffin@linaro.org>

description: |
  The Malibu AOSS block contains 123 pad slots, with a dedicated interrupt
  route from the GPIO input at offset 97 to an always-on SGIA input.
  This binding describes the bank in its Type-C alert input configuration.
  GPIO specifiers use the physical pad index and standard GPIO flags. The
  only supported GPIO index is 97. Interrupt specifiers use the pad index
  followed by IRQ_TYPE_LEVEL_LOW. The pad's interrupt parent uses the SGIA
  input number. The GPIO input is pulled up and cannot source an output.

properties:
  $nodename:
    pattern: "^gpio@[0-9a-f]+$"

  compatible:
    const: google,malibu-aoss-alert-gpio

  reg:
    maxItems: 1

  interrupts:
    maxItems: 1

  gpio-controller: true

  "#gpio-cells":
    const: 2

  interrupt-controller: true

  "#interrupt-cells":
    const: 2

  "#address-cells":
    const: 0

required:
  - compatible
  - reg
  - interrupts
  - gpio-controller
  - "#gpio-cells"
  - interrupt-controller
  - "#interrupt-cells"
  - "#address-cells"

additionalProperties: false
```

## Documentation/devicetree/bindings/interrupt-controller/google,malibu-sgia.yaml
```yaml
# SPDX-License-Identifier: (GPL-2.0-only OR BSD-2-Clause)
%YAML 1.2
---
$id: http://devicetree.org/schemas/interrupt-controller/google,malibu-sgia.yaml#
$schema: http://devicetree.org/meta-schemas/core.yaml#

title: Google Tensor G6 single-bank interrupt aggregator

maintainers:
  - Peter Griffin <peter.griffin@linaro.org>

description: |
  The Malibu interrupt aggregator combines up to 32 fixed level or pulse
  input lines onto one upstream interrupt. The interrupt specifier
  is the zero-based input number.

properties:
  compatible:
    enum:
      - google,malibu-level-sgia
      - google,malibu-pulse-sgia

  reg:
    maxItems: 1

  interrupts:
    maxItems: 1

  interrupt-controller: true

  '#interrupt-cells':
    const: 1

  '#address-cells':
    const: 0

  power-domains:
    maxItems: 1

required:
  - compatible
  - reg
  - interrupts
  - interrupt-controller
  - '#interrupt-cells'

additionalProperties: false
```

## Documentation/devicetree/bindings/mailbox/google,malibu-mba-v3-queue.yaml
```yaml
# SPDX-License-Identifier: (GPL-2.0-only OR BSD-2-Clause)
%YAML 1.2
---
$id: http://devicetree.org/schemas/mailbox/google,malibu-mba-v3-queue.yaml#
$schema: http://devicetree.org/meta-schemas/core.yaml#

title: Google Tensor G6 MBA v3 firmware mailbox queue

maintainers:
  - Peter Griffin <peter.griffin@linaro.org>

description: |
  The MBA v3 queue exchanges four-word frames with a firmware processor.
  Its hardware slots are addressed through one mailbox channel. The
  channel specifier is 0. The client manages firmware request and reply
  correlation and queues transmissions asynchronously. The queue starts
  from a fresh host boot, before the host has used any slots.

properties:
  compatible:
    const: google,malibu-mba-v3-queue

  reg:
    maxItems: 1

  interrupts:
    maxItems: 1

  '#mbox-cells':
    const: 1

required:
  - compatible
  - reg
  - interrupts
  - '#mbox-cells'

additionalProperties: false
```

## Documentation/devicetree/bindings/phy/google,malibu-dsi-cdphy.yaml
```yaml
# SPDX-License-Identifier: (GPL-2.0-only OR BSD-2-Clause)
%YAML 1.2
---
$id: http://devicetree.org/schemas/phy/google,malibu-dsi-cdphy.yaml#
$schema: http://devicetree.org/meta-schemas/core.yaml#

title: Google Malibu MIPI display C/D-PHY

maintainers:
  - Peter Griffin <peter.griffin@linaro.org>

properties:
  compatible:
    const: google,malibu-dsi-cdphy

  reg:
    items:
      - description: C/D-PHY transmitter registers
      - description: PHY APB register bank

  reg-names:
    items:
      - const: cdphy-tx
      - const: apb

  clocks:
    maxItems: 1

  clock-names:
    const: pllref

  power-domains:
    maxItems: 1

  '#phy-cells':
    const: 0

required:
  - compatible
  - reg
  - reg-names
  - clocks
  - clock-names
  - power-domains
  - '#phy-cells'

additionalProperties: false
```

## Documentation/devicetree/bindings/phy/google,malibu-usb2-phy.yaml
```yaml
# SPDX-License-Identifier: (GPL-2.0-only OR BSD-2-Clause)
%YAML 1.2
---
$id: http://devicetree.org/schemas/phy/google,malibu-usb2-phy.yaml#
$schema: http://devicetree.org/meta-schemas/core.yaml#

title: Google Tensor G6 Malibu USB2 PHY

maintainers:
  - Peter Griffin <peter.griffin@linaro.org>

description: |
  The Malibu eUSB2 PHY connects the DWC3 controller to a high-speed USB
  path. It takes USB role notifications and can apply USB2 resistor trim
  values from NVMEM.

properties:
  compatible:
    const: google,malibu-usb2-phy

  reg:
    items:
      - description: PHY top register window containing the VBUS controls.

  reg-names:
    const: usbdp_top

  '#phy-cells':
    const: 1
    description: The only supported PHY index is 0 for USB high-speed.

  clocks:
    maxItems: 1

  clock-names:
    const: usb2

  resets:
    maxItems: 1

  reset-names:
    const: usb2

  power-domains:
    maxItems: 1

  usb-role-switch:
    $ref: /schemas/types.yaml#/definitions/flag

  google,usb-cfg-csr:
    description: Syscon and offset of the USB2 configuration registers.
    $ref: /schemas/types.yaml#/definitions/phandle-array
    items:
      - items:
          - description: Configuration syscon phandle.
          - description: USB2 configuration register offset.

  nvmem-cells:
    items:
      - description: USB2 external resistor mode bit.
      - description: USB2 resistor trim code.

  nvmem-cell-names:
    items:
      - const: usb2-rext-external-mode
      - const: usb2-rext-ctrl

required:
  - compatible
  - reg
  - reg-names
  - '#phy-cells'
  - clocks
  - clock-names
  - resets
  - reset-names
  - power-domains
  - usb-role-switch
  - google,usb-cfg-csr

dependencies:
  nvmem-cells: [nvmem-cell-names]
  nvmem-cell-names: [nvmem-cells]

additionalProperties: false
```

## Documentation/devicetree/bindings/pinctrl/google,malibu-hsios-ufs-pinctrl.yaml
```yaml
# SPDX-License-Identifier: (GPL-2.0-only OR BSD-2-Clause)
%YAML 1.2
---
$id: http://devicetree.org/schemas/pinctrl/google,malibu-hsios-ufs-pinctrl.yaml#
$schema: http://devicetree.org/meta-schemas/core.yaml#

title: Google Tensor G6 Malibu HSIO-S UFS pad control

maintainers:
  - Peter Griffin <peter.griffin@linaro.org>

description: |
  The HSIO-S controller provides the three UFS device output pads at GPIO
  indices 0 (RESETB), 8 (power enable) and 11 (link startup selection).
  Its register interface is supplied by the HSIO-S CSR power domain.
  The HSIO-S standby controller supplies UFS reference clock pad control
  at pad index 0.

allOf:
  - $ref: pinctrl.yaml#
  - if:
      properties:
        compatible:
          const: google,malibu-hsios-ufs-pinctrl
    then:
      properties:
        ufs-refclk-on-pins: false
        ufs-refclk-off-pins: false
      required:
        - gpio-controller
        - "#gpio-cells"
        - gpio-ranges
        - power-domains
        - power-domain-names
        - ufs-gpio-pins
    else:
      properties:
        gpio-controller: false
        "#gpio-cells": false
        gpio-ranges: false
        power-domains: false
        power-domain-names: false
        ufs-gpio-pins: false
      required:
        - ufs-refclk-on-pins
        - ufs-refclk-off-pins

properties:
  compatible:
    enum:
      - google,malibu-hsios-ufs-pinctrl
      - google,malibu-hsios-ufs-stby-pinctrl

  reg:
    maxItems: 1

  gpio-controller: true

  "#gpio-cells":
    const: 2

  gpio-ranges:
    maxItems: 1

  power-domains:
    maxItems: 1

  power-domain-names:
    const: csr

  ufs-gpio-pins:
    type: object
    allOf:
      - $ref: pinmux-node.yaml#
      - $ref: pincfg-node.yaml#
    properties:
      pins:
        minItems: 1
        maxItems: 3
        items:
          enum:
            - XHSIOS_UFS_RESETB
            - XHSIOS_UFS_PWR_EN
            - XHSIOS_UFS_LSS
      function:
        const: hsios_gpio
      bias-disable: true
    required:
      - pins
      - function
      - bias-disable
    additionalProperties: false

  ufs-refclk-on-pins:
    $ref: "#/$defs/refclk-state"
    properties:
      google,drive-strength-code:
        const: 1
      bias-pull-down: false
    required:
      - bias-disable

  ufs-refclk-off-pins:
    $ref: "#/$defs/refclk-state"
    properties:
      google,drive-strength-code:
        const: 0
      bias-disable: false
    required:
      - bias-pull-down

required:
  - compatible
  - reg

unevaluatedProperties: false

$defs:
  refclk-state:
    type: object
    allOf:
      - $ref: pinmux-node.yaml#
      - $ref: pincfg-node.yaml#
    properties:
      pins:
        const: XHSIOS_UFS_REFCLK
      function:
        const: hsios_stby_ufs
      bias-disable: true
      bias-pull-down:
        type: boolean
      google,drive-strength-code:
        $ref: /schemas/types.yaml#/definitions/uint32
        enum: [0, 1]
        description: Malibu pad drive register encoding for the reference clock.
    required:
      - pins
      - function
      - google,drive-strength-code
    additionalProperties: false
```
