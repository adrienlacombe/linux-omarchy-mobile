## Documentation/devicetree/bindings/pinctrl/google,malibu-lsioe-i2c3-pinctrl.yaml
```yaml
# SPDX-License-Identifier: (GPL-2.0-only OR BSD-2-Clause)
%YAML 1.2
---
$id: http://devicetree.org/schemas/pinctrl/google,malibu-lsioe-i2c3-pinctrl.yaml#
$schema: http://devicetree.org/meta-schemas/core.yaml#

title: Google Tensor G6 LSIOE I2C3 pad control

maintainers:
  - Peter Griffin <peter.griffin@linaro.org>

description: |
  The LSIOE pad controller multiplexes the I2C3 SCL and SDA signals onto
  pads 25 and 26. It also supports putting the pads in a GPIO mux state
  with input enabled and the output disabled. The I2C3 mux uses the
  fixed pad drive setting for these pins. The bank's CSR power domain
  supplies the register interface.

allOf:
  - $ref: pinctrl.yaml#

properties:
  compatible:
    const: google,malibu-lsioe-i2c3-pinctrl

  reg:
    maxItems: 1

  power-domains:
    maxItems: 1

  power-domain-names:
    items:
      - const: csr_access_pd

patternProperties:
  '^[a-z0-9][a-z0-9-]*-pins$':
    type: object

    allOf:
      - $ref: pinmux-node.yaml#
      - $ref: pincfg-node.yaml#
      - if:
          properties:
            function:
              const: lsioe_i2c
        then:
          required:
            - bias-disable
            - output-enable
            - output-high
          properties:
            bias-pull-up: false
            output-disable: false
        else:
          required:
            - bias-pull-up
            - output-disable
          properties:
            bias-disable: false
            output-enable: false
            output-high: false

    properties:
      pins:
        minItems: 1
        maxItems: 2
        items:
          enum:
            - XLSIOE_I23C8_SCL
            - XLSIOE_I23C8_SDA

      function:
        enum:
          - lsioe_gpio
          - lsioe_i2c

      bias-disable: true
      bias-pull-up:
        type: boolean
      input-enable: true
      output-disable: true
      output-enable: true
      output-high: true

    required:
      - pins
      - function
      - input-enable

    additionalProperties: false

required:
  - compatible
  - reg
  - power-domains

unevaluatedProperties: false
```

## Documentation/devicetree/bindings/spmi/google,malibu-smartdv-spmi.yaml
```yaml
# SPDX-License-Identifier: (GPL-2.0-only OR BSD-2-Clause)
%YAML 1.2
---
$id: http://devicetree.org/schemas/spmi/google,malibu-smartdv-spmi.yaml#
$schema: http://devicetree.org/meta-schemas/core.yaml#

title: Google Tensor G6 SmartDV SPMI controller

maintainers:
  - Peter Griffin <peter.griffin@linaro.org>

description: |
  The Malibu SmartDV controller connects the host to PMIC functions on
  an SPMI bus. The controller reports the result of a transaction in
  its memory-mapped status register.

allOf:
  - $ref: spmi.yaml#

properties:
  compatible:
    const: google,malibu-smartdv-spmi

  reg:
    maxItems: 1

required:
  - compatible
  - reg
  - '#address-cells'
  - '#size-cells'

unevaluatedProperties: false
```

## Documentation/devicetree/bindings/ufs/google,malibu-ufshc.yaml
```yaml
# SPDX-License-Identifier: GPL-2.0-only OR BSD-2-Clause
%YAML 1.2
---
$id: http://devicetree.org/schemas/ufs/google,malibu-ufshc.yaml#
$schema: http://devicetree.org/meta-schemas/core.yaml#

title: Google Tensor G6 Malibu UFS host controller

maintainers:
  - Peter Griffin <peter.griffin@linaro.org>

description: |
  Malibu integrates a UFS HCI, a PHY with a dedicated SRAM window, and
  separate interrupt routing for the host and multiple completion queues.

properties:
  compatible:
    const: google,malibu-ufshc

  reg:
    items:
      - description: Host controller registers
      - description: UFS top registers
      - description: UFS security control registers
      - description: PHY SRAM
      - description: UFS subsystem registers
      - description: HSIO-S power sequencer status
      - description: Host controller power sequencer status
      - description: PHY power sequencer status

  reg-names:
    items:
      - const: hci
      - const: top
      - const: sec
      - const: phy-sram
      - const: subsystem
      - const: psm-hsios
      - const: psm-hci
      - const: psm-phy

  interrupts-extended:
    minItems: 17
    maxItems: 17
    description: |
      The host interrupt through the HSIO-S interrupt aggregator, followed
      by 16 direct GIC interrupts for the multiple completion queues.

  interrupt-names:
    items:
      - const: hci
      - const: mcq0
      - const: mcq1
      - const: mcq2
      - const: mcq3
      - const: mcq4
      - const: mcq5
      - const: mcq6
      - const: mcq7
      - const: mcq8
      - const: mcq9
      - const: mcq10
      - const: mcq11
      - const: mcq12
      - const: mcq13
      - const: mcq14
      - const: mcq15

  iommus:
    maxItems: 1

  dma-coherent: true

  clocks:
    items:
      - description: UFS device reference clock gate
      - description: 38.4 MHz M-PHY reference clock gate
      - description: UFS controller core clock gate
      - description: Deep Hibern8 clock gate

  clock-names:
    items:
      - const: gpio-ref
      - const: mphy-ref
      - const: core
      - const: deep-h8

  resets:
    maxItems: 1

  reset-names:
    const: phy

  power-domains:
    items:
      - description: UFS preparation domain
      - description: UFS core domain

  power-domain-names:
    items:
      - const: prep
      - const: core

  vdd0p75-supply:
    description: 0.75 V HSIO analog supply.

  vdd1p2-supply:
    description: 1.2 V HSIO analog supply.

  vcc-supply:
    description: 2.5 V UFS device supply.

  vccq-supply:
    description: 1.2 V UFS device I/O supply.

  phy-cal-data:
    $ref: /schemas/types.yaml#/definitions/uint32-array
    minItems: 74
    maxItems: 74
    description: |
      Per-device M-PHY calibration cells supplied by the bootloader. Each
      cell packs the register address in the low 16 bits and its value in
      the high 16 bits. The cells must be applied in their supplied order.

  google,rext-val:
    $ref: /schemas/types.yaml#/definitions/uint32
    maximum: 63
    description: Six-bit PHY resistor trim supplied by the bootloader.

  google,enable-hs-lss:
    type: boolean
    description: Enable the high-speed link startup sequence for calibrated boards.

  google,mphy-pmc-war:
    type: boolean
    description: Apply the M-PHY power mode change workaround.

  google,enable-phy-patching:
    type: boolean
    description: Load a firmware patch into M-PHY SRAM.

required:
  - compatible
  - reg
  - reg-names
  - interrupts-extended
  - interrupt-names
  - iommus
  - dma-coherent
  - clocks
  - clock-names
  - resets
  - reset-names
  - power-domains
  - power-domain-names
  - vdd0p75-supply
  - vdd1p2-supply
  - vcc-supply
  - vccq-supply

additionalProperties: false
```

## Documentation/devicetree/bindings/usb/google,malibu-dwc3.yaml
```yaml
# SPDX-License-Identifier: (GPL-2.0-only OR BSD-2-Clause)
%YAML 1.2
---
$id: http://devicetree.org/schemas/usb/google,malibu-dwc3.yaml#
$schema: http://devicetree.org/meta-schemas/core.yaml#

title: Google Tensor G6 Malibu DWC3 controller wrapper

maintainers:
  - Peter Griffin <peter.griffin@linaro.org>

description: |
  The wrapper supplies the DWC3 controller's clocks and resets, including
  the APB interface to the USB2 PHY configuration registers. This binding
  describes a high-speed peripheral configuration with a single child.

properties:
  compatible:
    const: google,malibu-dwc3

  reg:
    items:
      - description: USB top register window.

  clocks:
    items:
      - description: Non-sticky controller clock.
      - description: Sticky controller clock.
      - description: USB2 PHY APB clock.

  clock-names:
    items:
      - const: non-sticky
      - const: sticky
      - const: usb2-apb

  resets:
    items:
      - description: Non-sticky controller reset.
      - description: Sticky controller reset.
      - description: Dual-role controller bus reset.
      - description: USB2 PHY APB reset.
      - description: USB top configuration reset.

  reset-names:
    items:
      - const: non-sticky
      - const: sticky
      - const: drd-bus
      - const: usb2-apb
      - const: top

  power-domains:
    items:
      - description: USB controller power switch domain.
      - description: USB top domain.

  power-domain-names:
    items:
      - const: psw
      - const: top

  '#address-cells':
    const: 2

  '#size-cells':
    const: 2

  ranges: true

  dma-ranges: true

  usb-role-switch:
    $ref: /schemas/types.yaml#/definitions/flag
    description: Routes the device session to the USB2 PHY and repeater.

  google,usb2-repeater:
    $ref: /schemas/types.yaml#/definitions/phandle
    description: USB2 repeater on the path between the PHY and the connector.

patternProperties:
  '^usb@[0-9a-f]+$':
    $ref: snps,dwc3.yaml#
    properties:
      compatible:
        const: snps,dwc3
      dr_mode:
        const: peripheral
      maximum-speed:
        const: high-speed
      phys:
        maxItems: 1
      phy-names:
        items:
          - const: usb2-phy
      usb-role-switch: false
    required:
      - compatible
      - dr_mode
      - maximum-speed
      - phys
      - phy-names
      - iommus

required:
  - compatible
  - reg
  - clocks
  - clock-names
  - resets
  - reset-names
  - power-domains
  - power-domain-names
  - '#address-cells'
  - '#size-cells'
  - ranges

dependencies:
  usb-role-switch: ["google,usb2-repeater"]
  google,usb2-repeater: [usb-role-switch]

additionalProperties: false
```

## Documentation/devicetree/bindings/usb/maxim,max77779-tcpc-spmi.yaml
```yaml
# SPDX-License-Identifier: (GPL-2.0-only OR BSD-2-Clause)
%YAML 1.2
---
$id: http://devicetree.org/schemas/usb/maxim,max77779-tcpc-spmi.yaml#
$schema: http://devicetree.org/meta-schemas/core.yaml#

title: Maxim MAX77779 SPMI USB Type-C controller

maintainers:
  - Peter Griffin <peter.griffin@linaro.org>

description: |
  The MAX77779 Type-C controller is accessible over SPMI. This binding
  describes USB2 sink mode without USB Power Delivery. The controller
  reports changes through a level-low alert and controls the USB2 data
  switch before requesting the local device session.

properties:
  compatible:
    const: maxim,max77779-tcpc-spmi

  reg:
    maxItems: 1

  interrupts:
    maxItems: 1

  maxim,usb2-role-switch:
    $ref: /schemas/types.yaml#/definitions/phandle
    description: USB2 session switch that gates the local PHY and repeater.

  connector:
    $ref: /schemas/connector/usb-connector.yaml#
    unevaluatedProperties: false
    properties:
      compatible:
        const: usb-c-connector
      power-role:
        const: sink
      data-role:
        const: device
      typec-power-opmode:
        const: default
      self-powered: false
      port: false
      ports: false
    required:
      - compatible
      - power-role
      - data-role
      - typec-power-opmode
      - pd-disable

required:
  - compatible
  - reg
  - interrupts
  - maxim,usb2-role-switch
  - connector

additionalProperties: false
```

## Documentation/devicetree/bindings/usb/ti,tusb2e11.yaml
```yaml
# SPDX-License-Identifier: (GPL-2.0-only OR BSD-2-Clause)
%YAML 1.2
---
$id: http://devicetree.org/schemas/usb/ti,tusb2e11.yaml#
$schema: http://devicetree.org/meta-schemas/core.yaml#

title: Texas Instruments TUSB2E11 eUSB2 repeater

maintainers:
  - Peter Griffin <peter.griffin@linaro.org>

description: |
  The TUSB2E11 repeater bridges an eUSB2 PHY and a USB 2.0 port. In the
  regulator-controlled configuration, the USB role switch takes supply
  references in host or device mode and releases them in the disconnected
  state.

properties:
  compatible:
    const: ti,tusb2e11

  reg:
    maxItems: 1

  usb-role-switch:
    $ref: /schemas/types.yaml#/definitions/flag

  vdd33-supply:
    description: 3.3 V supply.

  vdd18-supply:
    description: 1.8 V nominal supply.

  vdd-reset-supply:
    description: Board supply that controls repeater reset sequencing.

required:
  - compatible
  - reg
  - usb-role-switch
  - vdd33-supply
  - vdd18-supply
  - vdd-reset-supply

additionalProperties: false
```

## Documentation/devicetree/bindings/watchdog/google,malibu-wdt.yaml
```yaml
# SPDX-License-Identifier: (GPL-2.0-only OR BSD-2-Clause)
%YAML 1.2
---
$id: http://devicetree.org/schemas/watchdog/google,malibu-wdt.yaml#
$schema: http://devicetree.org/meta-schemas/core.yaml#

title: Google Tensor G6 cluster watchdog

maintainers:
  - Peter Griffin <peter.griffin@linaro.org>

description: |
  Malibu has two watchdogs clocked by the Global Time Counter oscillator.
  The early handoff driver services watchdogs left running by the bootloader
  and preserves their existing expiry action.

allOf:
  - $ref: watchdog.yaml#

properties:
  compatible:
    const: google,malibu-wdt

  reg:
    maxItems: 1

  clocks:
    maxItems: 1

required:
  - compatible
  - reg
  - clocks
  - timeout-sec

unevaluatedProperties: false
```
